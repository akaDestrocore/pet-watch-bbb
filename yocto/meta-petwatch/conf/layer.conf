## yocto/meta-petwatch/conf/layer.conf
```bitbake
# We have a conf and classes directory, add to BBPATH
BBPATH .= ":${LAYERDIR}"

# We have recipes-* directories, add to BBFILES
BBFILES += "${LAYERDIR}/recipes*/*/*.bb \
            ${LAYERDIR}/recipes*/*/*.bbappend"

BBFILE_COLLECTIONS += "meta-petwatch"
BBFILE_PATTERN_meta-petwatch = "^${LAYERDIR}/"
BBFILE_PRIORITY_meta-petwatch = "6"

LAYERDEPENDS_meta-petwatch = " \
    core \
    openembedded-layer \
    meta-python \
    multimedia-layer \
    arm-toolchain \
    meta-arm \
    meta-ti-bsp \
"
LAYERSERIES_COMPAT_meta-petwatch = "kirkstone"
```
